## boards/arm/holyiot_dongle/Kconfig
```kconfig
# Holyiot nrf52840 dongle board configuration

# Copyright (c) 2018-2023 Nordic Semiconductor ASA
# SPDX-License-Identifier: Apache-2.0

if BOARD_HOLYIOT_DONGLE

# disable DCDC mode for holyiot dongle
config BOARD_ENABLE_DCDC
	bool "DCDC mode"
	select SOC_DCDC_NRF52X
	default n

config BOARD_ENABLE_DCDC_HV
	bool "High Voltage DCDC converter"
	select SOC_DCDC_NRF52X_HV
	default n

config BOARD_HAS_NRF5_BOOTLOADER
	bool "Board has nRF5 bootloader"
	default y
	help
	  If selected, applications are linked so that they can be loaded by Nordic
	  nRF5 bootloader.

config BOARD_SERIAL_BACKEND_CDC_ACM
	bool "USB CDC"
	default y

endif # BOARD_HOLYIOT_DONGLE
```

## boards/arm/holyiot_dongle/Kconfig.board
```kconfig
# Holyiot nrf52840 dongle board configuration

# Copyright (c) 2018 Nordic Semiconductor ASA
# SPDX-License-Identifier: Apache-2.0

config BOARD_HOLYIOT_DONGLE
	bool "Holyiot DONGLE NRF52840"
	depends on SOC_NRF52840_QIAA
```

## boards/arm/sloc_wb55rg/Kconfig.board
```kconfig
# STM32WB55RG Nucleo board configuration

# Copyright (c) 2019 Linaro Limited
# SPDX-License-Identifier: Apache-2.0

config BOARD_SLOC_WB55RG
	bool "Sloc WB55RG Development Board"
	depends on SOC_STM32WB55XX
```

## boards/arm/sloc_wb55rg/Kconfig.defconfig
```kconfig
# STM32LWB55RG Nucleo board configuration

# Copyright (c) 2019 Linaro Limited
# SPDX-License-Identifier: Apache-2.0

if BOARD_SLOC_WB55RG

config BOARD
	default "sloc_wb55rg"

choice BT_HCI_BUS_TYPE
	default BT_STM32_IPM
	depends on BT
endchoice

endif # BOARD_SLOC_WB55RG
```

## boards/maker_diary/connectkit_nrf52840/Kconfig.connectkit_nrf52840
```kconfig
# Connectkit_nrf52840 board configuration

# Copyright (c) 2018 makerdiary.com
# SPDX-License-Identifier: Apache-2.0

config BOARD_CONNECTKIT_NRF52840
	select SOC_NRF52840_QIAA
```

## boards/maker_diary/connectkit_nrf52840/Kconfig.defconfig
```kconfig
#
# Copyright (c) 2016-2023 Makerdiary
#
# SPDX-License-Identifier: Apache-2.0
#

if BOARD_CONNECTKIT_NRF52840

config BT_CTLR
    default BT

if LOG

# Logger cannot use itself to log
choice USB_CDC_ACM_LOG_LEVEL_CHOICE
	default USB_CDC_ACM_LOG_LEVEL_OFF
endchoice

endif # LOG

endif # BOARD_CONNECTKIT_NRF52840
```

## boards/maker_diary/connectkit_nrf52840/board.yml
```yaml
board:
  name: connectkit_nrf52840
  vendor: makerdiary
  socs:
  - name: nrf52840
```

## samples/subsys/fs/littlefs/boards/stm32f723e_disco.conf
```kconfig
# get some debug log level
# CONFIG_LOG_DBG=y
CONFIG_LOG_BUFFER_SIZE=4096
# CONFIG_FLASH_LOG_LEVEL_DBG=y
# CONFIG_FS_LOG_LEVEL_DBG=y

# enable QSPI driver for stm32 board
CONFIG_FLASH_STM32_QSPI=y

# little fs config
CONFIG_FILE_SYSTEM_MKFS=y
CONFIG_APP_LITTLEFS_STORAGE_FLASH=y
CONFIG_FS_LITTLEFS_FC_HEAP_SIZE=8192
# CONFIG_APP_WIPE_STORAGE=y

# MCU config
CONFIG_MAIN_STACK_SIZE=8096
CONFIG_MPU_ALLOW_FLASH_WRITE=y
```

## samples/subsys/usb/mass/boards/stm32f723e_disco.conf
```kconfig
CONFIG_FLASH=y
CONFIG_FLASH_MAP=y
CONFIG_FLASH_PAGE_LAYOUT=y
CONFIG_FLASH_STM32_QSPI=y

# little fs config
# CONFIG_FILE_SYSTEM=y
# CONFIG_FILE_SYSTEM_LITTLEFS=y
# CONFIG_FILE_SYSTEM_MKFS=y
# CONFIG_APP_LITTLEFS_STORAGE_FLASH=y
# CONFIG_FS_LITTLEFS_FC_HEAP_SIZE=8192
```
